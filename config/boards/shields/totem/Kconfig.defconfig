## config/boards/shields/totem/Kconfig.defconfig
```kconfig
# Copyright (c) 2022 The ZMK Contributors
# SPDX-License-Identifier: MIT

if SHIELD_TOTEM_LEFT

config ZMK_SPLIT_ROLE_CENTRAL
    default y

config BT_GAP_AUTO_UPDATE_CONN_PARAMS
    default y

endif

if SHIELD_TOTEM_LEFT || SHIELD_TOTEM_RIGHT

config ZMK_SPLIT
    default y

config ZMK_KEYBOARD_NAME
    default "TOTEM"
    
endif
```

## config/west.yml
```yaml
manifest:
  remotes:
    - name: spamwax
      url-base: https://github.com/spamwax
  projects:
    - name: zmk
      remote: spamwax
      revision: main
      import: app/west.yml
  self:
    path: config
```
